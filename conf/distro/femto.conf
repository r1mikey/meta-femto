## conf/distro/femto.conf
```bitbake
require conf/distro/poky.conf

DISTRO = "femto"
DISTRO_NAME = "Femto Linux"
DISTRO_VERSION = "next+snapshot-${DATE}"
DISTRO_CODENAME = "master"
SDK_VENDOR = "-femtosdk"
MAINTAINER = "Femto Linux <r1mikey@gmail.com>"
TARGET_VENDOR = "-femto"

VIRTUAL-RUNTIME_dev_manager = ""
```

## conf/layer.conf
```bitbake
BBPATH .= ":${LAYERDIR}"

# We have a recipes directory containing .bb and .bbappend files, add to BBFILES
#BBFILES += "${LAYERDIR}/recipes-*/*/*.bb \
#            ${LAYERDIR}/recipes-*/*/*.bbappend"

#BBFILE_COLLECTIONS += "femto"
#BBFILE_PATTERN_femto := "^${LAYERDIR}/"
#BBFILE_PRIORITY_femto = "6"

## Additional license directories.
#LICENSE_PATH += "${LAYERDIR}/files/custom-licenses"
```
